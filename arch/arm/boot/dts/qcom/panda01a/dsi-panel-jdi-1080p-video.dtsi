/* Copyright (c) 2013-2015, The Linux Foundation. All rights reserved.
 *
 * This program is free software; you can redistribute it and/or modify
 * it under the terms of the GNU General Public License version 2 and
 * only version 2 as published by the Free Software Foundation.
 *
 * This program is distributed in the hope that it will be useful,
 * but WITHOUT ANY WARRANTY; without even the implied warranty of
 * MERCHANTABILITY or FITNESS FOR A PARTICULAR PURPOSE.  See the
 * GNU General Public License for more details.
 */

&mdss_mdp {
	mdss_dsi_jdi_1080p_cmd: qcom,mdss_dsi_jdi_1080p_cmd {
		qcom,mdss-dsi-panel-name = "jdi 1080p command mode dsi panel";
		qcom,mdss-dsi-panel-controller = <49>;
		qcom,mdss-dsi-panel-type = "dsi_cmd_mode";
		qcom,mdss-dsi-panel-destination = "display_1";
		qcom,mdss-dsi-panel-framerate = <60>;
		qcom,mdss-dsi-virtual-channel-id = <0>;
		qcom,mdss-dsi-stream = <0>;
		qcom,mdss-dsi-panel-width = <1080>;
		qcom,mdss-dsi-panel-height = <1920>;
		qcom,mdss-pan-physical-width-dimension = <65>;
		qcom,mdss-pan-physical-height-dimension = <115>;
		qcom,mdss-dsi-h-front-porch = < 0x20 >;
		qcom,mdss-dsi-h-back-porch = < 0x20 >;
		qcom,mdss-dsi-h-pulse-width = < 0x08 >;
		qcom,mdss-dsi-h-sync-skew = <0>;
		qcom,mdss-dsi-v-back-porch = < 0x12 >;
		qcom,mdss-dsi-v-front-porch = < 0x02 >;
		qcom,mdss-dsi-v-pulse-width = < 0x02 >;
		qcom,mdss-dsi-h-left-border = <0>;
		qcom,mdss-dsi-h-right-border = <0>;
		qcom,mdss-dsi-v-top-border = <0>;
		qcom,mdss-dsi-v-bottom-border = <0>;
		qcom,mdss-dsi-bpp = < 0x18 >;
		qcom,mdss-dsi-color-order = "rgb_swap_rgb";
		qcom,mdss-dsi-underflow-color = < 0xff >;
		qcom,mdss-dsi-border-color = <0>;
		qcom,mdss-dsi-on-command = < 0x23010000 0x2ff 0x20230100 0x02 0x12301 0x00 0x2012223 0x1000000 0x20245 0x23010000 0x203 0x55230100 0x02 0x4002301 0x00 0x2059023 0x1000000 0x206b2 0x23010000 0x207 0xb2230100 0x02 0x80c2301 0x00 0x209d723 0x1000000 0x20ad7 0x23010000 0x20b 0xd7230100 0x02 0xcd72301 0x00 0x20d0023 0x1000000 0x20eb3 0x23010000 0x20f 0xac230100 0x02 0x111d2301 0x00 0x2121d23 0x1000000 0x21303 0x23010000 0x214 0xa230100 0x02 0x159a2301 0x00 0x2169a23 0x1000000 0x21766 0x23010000 0x218 0x63230100 0x02 0x19632301 0x00 0x21a6323 0x1000000 0x21c44 0x23010000 0x21d 0x44230100 0x02 0x30622301 0x00 0x231a823 0x1000000 0x232d8 0x23010000 0x258 0x230100 0x02 0x59002301 0x00 0x25a0023 0x1000000 0x25b00 0x23010000 0x25c 0x230100 0x02 0x5d002301 0x00 0x25e0023 0x1000000 0x25f00 0x23010000 0x260 0x80230100 0x02 0x61212301 0x00 0x2624323 0x1000000 0x26365 0x23010000 0x264 0x87230100 0x02 0x65a92301 0x00 0x2660b23 0x1000000 0x26710 0x23010000 0x269 0x99230100 0x02 0x6b432301 0x00 0x26d3323 0x1000000 0x27154 0x23010000 0x272 0x11230100 0x02 0x74102301 0x00 0x2fb0123 0x1000000 0x2ff23 0x23010000 0x207 0x20230100 0x02 0x8032301 0x00 0x2460023 0x1000000 0x2fb01 0x23010000 0x2ff 0x24230100 0x02 0xc2301 0x00 0x2010423 0x1000000 0x2021b 0x23010000 0x203 0xf230100 0x02 0x41d2301 0x00 0x2050023 0x1000000 0x20601 0x23010000 0x207 0x19230100 0x02 0x8002301 0x00 0x2090023 0x1000000 0x20a17 0x23010000 0x20b 0x15230100 0x02 0xc132301 0x00 0x20d1823 0x1000000 0x20e16 0x23010000 0x20f 0x14230100 0x02 0x10002301 0x00 0x2110323 0x1000000 0x2121b 0x23010000 0x213 0x230100 0x02 0x141d2301 0x00 0x2150023 0x1000000 0x21601 0x23010000 0x217 0x19230100 0x02 0x18002301 0x00 0x2190023 0x1000000 0x21a17 0x23010000 0x21b 0x15230100 0x02 0x1c132301 0x00 0x21d1823 0x1000000 0x21e16 0x23010000 0x21f 0x14230100 0x02 0x20002301 0x00 0x2210123 0x1000000 0x22210 0x23010000 0x223 0x13230100 0x02 0x24132301 0x00 0x2255d23 0x1000000 0x22613 0x23010000 0x227 0x13230100 0x02 0x29d82301 0x00 0x22a1523 0x1000000 0x22f02 0x23010000 0x230 0x2230100 0x02 0x31002301 0x00 0x2322323 0x1000000 0x23300 0x23010000 0x234 0x3230100 0x02 0x354b2301 0x00 0x2360023 0x1000000 0x2371d 0x23010000 0x238 0x8230100 0x02 0x39032301 0x00 0x23a4b23 0x1000000 0x23f01 0x23010000 0x240 0x1230100 0x02 0x41e02301 0x00 0x2420123 0x1000000 0x24350 0x23010000 0x244 0x58230100 0x02 0x45002301 0x00 0x2461d23 0x1000000 0x24708 0x23010000 0x248 0x50230100 0x02 0x49582301 0x00 0x2590223 0x1000000 0x25a06 0x23010000 0x25f 0x4d230100 0x02 0x67042301 0x00 0x26e1023 0x1000000 0x27200 0x23010000 0x273 0x230100 0x02 0x74032301 0x00 0x2751423 0x1000000 0x27602 0x23010000 0x277 0x1230100 0x02 0x78002301 0x00 0x2790023 0x1000000 0x27a00 0x23010000 0x27b 0x91230100 0x02 0x7cda2301 0x00 0x27d1023 0x1000000 0x27e03 0x23010000 0x27f 0x14230100 0x02 0x80002301 0x00 0x2810223 0x1000000 0x28201 0x23010000 0x283 0x230100 0x02 0x84022301 0x00 0x2850223 0x1000000 0x2861b 0x23010000 0x287 0x1b230100 0x02 0x881b2301 0x00 0x2891b23 0x1000000 0x28a33 0x23010000 0x28b 0xf0230100 0x02 0x8c002301 0x00 0x28e0223 0x1000000 0x29051 0x23010000 0x291 0x40230100 0x02 0x92512301 0x00 0x2930223 0x1000000 0x29406 0x23010000 0x295 0x55230100 0x02 0x96552301 0x00 0x297a323 0x1000000 0x29800 0x23010000 0x299 0x33230100 0x02 0x9a032301 0x00 0x29b0f23 0x1000000 0x29c01 0x23010000 0x29d 0xb0230100 0x02 0xa20b2301 0x00 0x2a51023 0x1000000 0x2a921 0x23010000 0x2aa 0x44230100 0x02 0xab002301 0x00 0x2ac0023 0x1000000 0x2ad08 0x23010000 0x2ae 0x3c230100 0x02 0xaf0f2301 0x00 0x2b03523 0x1000000 0x2b108 0x23010000 0x2b2 0x3c230100 0x02 0xb30a2301 0x00 0x2b4da23 0x1000000 0x2b555 0x23010000 0x2ba 0x23230100 0x02 0xbb002301 0x00 0x2bc2323 0x1000000 0x2c424 0x23010000 0x2c5 0x30230100 0x02 0xc6002301 0x00 0x2d30023 0x1000000 0x2d450 0x23010000 0x2d5 0x45230100 0x02 0xd6082301 0x00 0x2d74523 0x1000000 0x2d808 0x23010000 0x2d9 0x74230100 0x02 0xda742301 0x00 0x2db9123 0x1000000 0x2deff 0x23010000 0x2e3 0x2230100 0x02 0xea002301 0x00 0x2eb0023 0x1000000 0x2ec00 0x23010000 0x2ee 0x1230100 0x02 0xef062301 0x00 0x2f05023 0x1000000 0x2f150 0x23010000 0x2f2 0xd230100 0x02 0xf3482301 0x00 0x2f4d023 0x1000000 0x2f505 0x23010000 0x2f6 0x230100 0x02 0xf7002301 0x00 0x2f80023 0x1000000 0x2f900 0x23010000 0x2fb 0x1230100 0x02 0xff262301 0x00 0x200ab23 0x1000000 0x20100 0x23010000 0x202 0x64230100 0x02 0x3062301 0x00 0x2046623 0x1000000 0x20525 0x23010000 0x206 0x30230100 0x02 0x7012301 0x00 0x20a0823 0x1000000 0x20b55 0x23010000 0x20c 0x14230100 0x02 0xd282301 0x00 0x20e0023 0x1000000 0x20fff 0x23010000 0x210 0x230100 0x02 0x11012301 0x00 0x2120723 0x1000000 0x21303 0x23010000 0x214 0x1230100 0x02 0x15022301 0x00 0x2160023 0x1000000 0x21940 0x23010000 0x21a 0x3230100 0x02 0x1b232301 0x00 0x21c1123 0x1000000 0x21d01 0x23010000 0x21e 0x93230100 0x02 0x1f062301 0x00 0x2200023 0x1000000 0x22103 0x23010000 0x222 0x20230100 0x02 0x23232301 0x00 0x2240023 0x1000000 0x225a5 0x23010000 0x226 0x80230100 0x02 0x27a32301 0x00 0x22f0523 0x1000000 0x23027 0x23010000 0x231 0x30230100 0x02 0x323b2301 0x00 0x2331e23 0x1000000 0x2341e 0x23010000 0x235 0x45230100 0x02 0x41202301 0x00 0x2420323 0x1000000 0x24300 0x23010000 0x244 0x11230100 0x02 0x45012301 0x00 0x2461223 0x1000000 0x24706 0x23010000 0x248 0x230100 0x02 0x49032301 0x00 0x24a0023 0x1000000 0x24b00 0x23010000 0x24c 0x1230100 0x02 0x4d532301 0x00 0x24e0123 0x1000000 0x24f51 0x23010000 0x250 0xa230100 0x02 0x519a2301 0x00 0x2523023 0x1000000 0x2531a 0x23010000 0x254 0x3c230100 0x02 0x553c2301 0x00 0x2563b23 0x1000000 0x25b40 0x23010000 0x25c 0x3230100 0x02 0x5d232301 0x00 0x25e1123 0x1000000 0x25f01 0x23010000 0x260 0x93230100 0x02 0x61062301 0x00 0x2620023 0x1000000 0x26303 0x23010000 0x264 0x20230100 0x02 0x65232301 0x00 0x2660023 0x1000000 0x267a5 0x23010000 0x268 0x80230100 0x02 0x69a32301 0x00 0x26a0523 0x1000000 0x26b27 0x23010000 0x26c 0x30230100 0x02 0x6d3b2301 0x00 0x26e1e23 0x1000000 0x26f1e 0x23010000 0x270 0x45230100 0x02 0x71402301 0x00 0x2720323 0x1000000 0x27323 0x23010000 0x274 0x11230100 0x02 0x75012301 0x00 0x2769323 0x1000000 0x27706 0x23010000 0x278 0x230100 0x02 0x79032301 0x00 0x27a2023 0x1000000 0x27b23 0x23010000 0x27c 0x230100 0x02 0x7da52301 0x00 0x27e8023 0x1000000 0x27fa3 0x23010000 0x280 0x5230100 0x02 0x81272301 0x00 0x2823023 0x1000000 0x2833b 0x23010000 0x284 0x1e230100 0x02 0x851e2301 0x00 0x2864523 0x1000000 0x28712 0x23010000 0x288 0x12230100 0x02 0x89122301 0x00 0x28a1223 0x1000000 0x28b12 0x23010000 0x28c 0x12230100 0x02 0x8d002301 0x00 0x28e1823 0x1000000 0x28f18 0x23010000 0x290 0x230100 0x02 0x91082301 0x00 0x292fc23 0x1000000 0x29301 0x23010000 0x294 0x1230100 0x02 0x95012301 0x00 0x2960123 0x1000000 0x29710 0x23010000 0x298 0x42230100 0x02 0x99002301 0x00 0x29a1323 0x1000000 0x29b02 0x23010000 0x29c 0x1230100 0x02 0x9d022301 0x00 0x29e0123 0x1000000 0x29f0d 0x23010000 0x2a0 0x230100 0x02 0xa2002301 0x00 0x2a32223 0x1000000 0x2a400 0x23010000 0x2a5 0x80230100 0x02 0xa6802301 0x00 0x2ac7123 0x1000000 0x2ad77 0x23010000 0x2ae 0x77230100 0x02 0xb0802301 0x00 0x2b18023 0x1000000 0x2b280 0x23010000 0x2b4 0x80230100 0x02 0xb5802301 0x00 0x2b78023 0x1000000 0x2b880 0x23010000 0x2ba 0x13230100 0x02 0xbb132301 0x00 0x2bc0023 0x1000000 0x2bd02 0x23010000 0x2be 0x4f230100 0x02 0xbf502301 0x00 0x2c05823 0x1000000 0x2c302 0x23010000 0x2c4 0x1230100 0x02 0xc5032301 0x00 0x2c61523 0x1000000 0x2c749 0x23010000 0x2c8 0xc230100 0x02 0xc9562301 0x00 0x2ca0023 0x1000000 0x2cb18 0x23010000 0x2cc 0x57230100 0x02 0xce2e2301 0x00 0x2cf0023 0x1000000 0x2d0b0 0x23010000 0x2d1 0xa230100 0x02 0xd20a2301 0x00 0x2d30b23 0x1000000 0x2e105 0x23010000 0x2e2 0xd230100 0x02 0xe3052301 0x00 0x2e40d23 0x1000000 0x2e505 0x23010000 0x2e6 0xd230100 0x02 0xe7052301 0x00 0x2e80d23 0x1000000 0x2e91c 0x23010000 0x2ea 0x22230100 0x02 0xeb1c2301 0x00 0x2fb0123 0x1000000 0x2ff20 0x23010000 0x275 0x230100 0x02 0x76002301 0x00 0x2770023 0x1000000 0x27816 0x23010000 0x279 0x230100 0x02 0x7a412301 0x00 0x27b0023 0x1000000 0x27c61 0x23010000 0x27d 0x230100 0x02 0x7e802301 0x00 0x27f0023 0x1000000 0x28098 0x23010000 0x281 0x230100 0x02 0x82af2301 0x00 0x2830023 0x1000000 0x284c3 0x23010000 0x285 0x230100 0x02 0x86d62301 0x00 0x2870123 0x1000000 0x28812 0x23010000 0x289 0x1230100 0x02 0x8a402301 0x00 0x28b0123 0x1000000 0x28c86 0x23010000 0x28d 0x1230100 0x02 0x8ebb2301 0x00 0x28f0223 0x1000000 0x2900a 0x23010000 0x291 0x2230100 0x02 0x924a2301 0x00 0x2930223 0x1000000 0x2944c 0x23010000 0x295 0x2230100 0x02 0x96892301 0x00 0x2970223 0x1000000 0x298ca 0x23010000 0x299 0x2230100 0x02 0x9af22301 0x00 0x29b0323 0x1000000 0x29c23 0x23010000 0x29d 0x3230100 0x02 0x9e452301 0x00 0x29f0323 0x1000000 0x2a073 0x23010000 0x2a2 0x3230100 0x02 0xa3822301 0x00 0x2a40323 0x1000000 0x2a591 0x23010000 0x2a6 0x3230100 0x02 0xa7a22301 0x00 0x2a90323 0x1000000 0x2aab4 0x23010000 0x2ab 0x3230100 0x02 0xacc72301 0x00 0x2ad0323 0x1000000 0x2aedc 0x23010000 0x2af 0x3230100 0x02 0xb0f42301 0x00 0x2b10323 0x1000000 0x2b2ff 0x23010000 0x2b3 0x230100 0x02 0xb4002301 0x00 0x2b50023 0x1000000 0x2b616 0x23010000 0x2b7 0x230100 0x02 0xb8412301 0x00 0x2b90023 0x1000000 0x2ba61 0x23010000 0x2bb 0x230100 0x02 0xbc802301 0x00 0x2bd0023 0x1000000 0x2be98 0x23010000 0x2bf 0x230100 0x02 0xc0af2301 0x00 0x2c10023 0x1000000 0x2c2c3 0x23010000 0x2c3 0x230100 0x02 0xc4d62301 0x00 0x2c50123 0x1000000 0x2c612 0x23010000 0x2c7 0x1230100 0x02 0xc8402301 0x00 0x2c90123 0x1000000 0x2ca86 0x23010000 0x2cb 0x1230100 0x02 0xccbb2301 0x00 0x2cd0223 0x1000000 0x2ce0a 0x23010000 0x2cf 0x2230100 0x02 0xd04a2301 0x00 0x2d10223 0x1000000 0x2d24c 0x23010000 0x2d3 0x2230100 0x02 0xd4892301 0x00 0x2d50223 0x1000000 0x2d6ca 0x23010000 0x2d7 0x2230100 0x02 0xd8f22301 0x00 0x2d90323 0x1000000 0x2da23 0x23010000 0x2db 0x3230100 0x02 0xdc452301 0x00 0x2dd0323 0x1000000 0x2de73 0x23010000 0x2df 0x3230100 0x02 0xe0822301 0x00 0x2e10323 0x1000000 0x2e291 0x23010000 0x2e3 0x3230100 0x02 0xe4a22301 0x00 0x2e50323 0x1000000 0x2e6b4 0x23010000 0x2e7 0x3230100 0x02 0xe8c72301 0x00 0x2e90323 0x1000000 0x2eadc 0x23010000 0x2eb 0x3230100 0x02 0xecf42301 0x00 0x2ed0323 0x1000000 0x2eeff 0x23010000 0x2ef 0x230100 0x02 0xf0662301 0x00 0x2f10023 0x1000000 0x2f275 0x23010000 0x2f3 0x230100 0x02 0xf4912301 0x00 0x2f50023 0x1000000 0x2f6a7 0x23010000 0x2f7 0x230100 0x02 0xf8bd2301 0x00 0x2f90023 0x1000000 0x2facf 0x23010000 0x2fb 0x1230100 0x02 0xff212301 0x00 0x2000023 0x1000000 0x201e1 0x23010000 0x202 0x230100 0x02 0x3f02301 0x00 0x2040023 0x1000000 0x205ff 0x23010000 0x206 0x1230100 0x02 0x7302301 0x00 0x2080123 0x1000000 0x20958 0x23010000 0x20a 0x1230100 0x02 0xb962301 0x00 0x20c0123 0x1000000 0x20dc6 0x23010000 0x20e 0x2230100 0x02 0xf112301 0x00 0x2100223 0x1000000 0x2114f 0x23010000 0x212 0x2230100 0x02 0x13512301 0x00 0x2140223 0x1000000 0x2158c 0x23010000 0x216 0x2230100 0x02 0x17cd2301 0x00 0x2180223 0x1000000 0x219f4 0x23010000 0x21a 0x3230100 0x02 0x1b252301 0x00 0x21c0323 0x1000000 0x21d48 0x23010000 0x21e 0x3230100 0x02 0x1f752301 0x00 0x2200323 0x1000000 0x22183 0x23010000 0x222 0x3230100 0x02 0x23932301 0x00 0x2240323 0x1000000 0x225a3 0x23010000 0x226 0x3230100 0x02 0x27b52301 0x00 0x2280323 0x1000000 0x229c8 0x23010000 0x22a 0x3230100 0x02 0x2bdd2301 0x00 0x22d0323 0x1000000 0x22ff4 0x23010000 0x230 0x3230100 0x02 0x31ff2301 0x00 0x2320023 0x1000000 0x23366 0x23010000 0x234 0x230100 0x02 0x35752301 0x00 0x2360023 0x1000000 0x23791 0x23010000 0x238 0x230100 0x02 0x39a72301 0x00 0x23a0023 0x1000000 0x23bbd 0x23010000 0x23d 0x230100 0x02 0x3fcf2301 0x00 0x2400023 0x1000000 0x241e1 0x23010000 0x242 0x230100 0x02 0x43f02301 0x00 0x2440023 0x1000000 0x245ff 0x23010000 0x246 0x1230100 0x02 0x47302301 0x00 0x2480123 0x1000000 0x24958 0x23010000 0x24a 0x1230100 0x02 0x4b962301 0x00 0x24c0123 0x1000000 0x24dc6 0x23010000 0x24e 0x2230100 0x02 0x4f112301 0x00 0x2500223 0x1000000 0x2514f 0x23010000 0x252 0x2230100 0x02 0x53512301 0x00 0x2540223 0x1000000 0x2558c 0x23010000 0x256 0x2230100 0x02 0x58cd2301 0x00 0x2590223 0x1000000 0x25af4 0x23010000 0x25b 0x3230100 0x02 0x5c252301 0x00 0x25d0323 0x1000000 0x25e48 0x23010000 0x25f 0x3230100 0x02 0x60752301 0x00 0x2610323 0x1000000 0x26283 0x23010000 0x263 0x3230100 0x02 0x64932301 0x00 0x2650323 0x1000000 0x266a3 0x23010000 0x267 0x3230100 0x02 0x68b52301 0x00 0x2690323 0x1000000 0x26ac8 0x23010000 0x26b 0x3230100 0x02 0x6cdd2301 0x00 0x26d0323 0x1000000 0x26ef4 0x23010000 0x26f 0x3230100 0x02 0x70ff2301 0x00 0x2710023 0x1000000 0x272b8 0x23010000 0x273 0x230100 0x02 0x74c22301 0x00 0x2750023 0x1000000 0x276d5 0x23010000 0x277 0x230100 0x02 0x78e52301 0x00 0x2790023 0x1000000 0x27af5 0x23010000 0x27b 0x1230100 0x02 0x7c032301 0x00 0x27d0123 0x1000000 0x27e11 0x23010000 0x27f 0x1230100 0x02 0x801d2301 0x00 0x2810123 0x1000000 0x28229 0x23010000 0x283 0x1230100 0x02 0x84522301 0x00 0x2850123 0x1000000 0x28673 0x23010000 0x287 0x1230100 0x02 0x88aa2301 0x00 0x2890123 0x1000000 0x28ad5 0x23010000 0x28b 0x2230100 0x02 0x8c1c2301 0x00 0x28d0223 0x1000000 0x28e57 0x23010000 0x28f 0x2230100 0x02 0x90592301 0x00 0x2910223 0x1000000 0x29292 0x23010000 0x293 0x2230100 0x02 0x94d22301 0x00 0x2950223 0x1000000 0x296f9 0x23010000 0x297 0x3230100 0x02 0x982a2301 0x00 0x2990323 0x1000000 0x29a4c 0x23010000 0x29b 0x3230100 0x02 0x9c792301 0x00 0x29d0323 0x1000000 0x29e87 0x23010000 0x29f 0x3230100 0x02 0xa0962301 0x00 0x2a20323 0x1000000 0x2a3a6 0x23010000 0x2a4 0x3230100 0x02 0xa5b72301 0x00 0x2a60323 0x1000000 0x2a7ca 0x23010000 0x2a9 0x3230100 0x02 0xaade2301 0x00 0x2ab0323 0x1000000 0x2acf4 0x23010000 0x2ad 0x3230100 0x02 0xaeff2301 0x00 0x2af0023 0x1000000 0x2b0b8 0x23010000 0x2b1 0x230100 0x02 0xb2c22301 0x00 0x2b30023 0x1000000 0x2b4d5 0x23010000 0x2b5 0x230100 0x02 0xb6e52301 0x00 0x2b70023 0x1000000 0x2b8f5 0x23010000 0x2b9 0x1230100 0x02 0xba032301 0x00 0x2bb0123 0x1000000 0x2bc11 0x23010000 0x2bd 0x1230100 0x02 0xbe1d2301 0x00 0x2bf0123 0x1000000 0x2c029 0x23010000 0x2c1 0x1230100 0x02 0xc2522301 0x00 0x2c30123 0x1000000 0x2c473 0x23010000 0x2c5 0x1230100 0x02 0xc6aa2301 0x00 0x2c70123 0x1000000 0x2c8d5 0x23010000 0x2c9 0x2230100 0x02 0xca1c2301 0x00 0x2cb0223 0x1000000 0x2cc57 0x23010000 0x2cd 0x2230100 0x02 0xce592301 0x00 0x2cf0223 0x1000000 0x2d092 0x23010000 0x2d1 0x2230100 0x02 0xd2d22301 0x00 0x2d30223 0x1000000 0x2d4f9 0x23010000 0x2d5 0x3230100 0x02 0xd62a2301 0x00 0x2d70323 0x1000000 0x2d84c 0x23010000 0x2d9 0x3230100 0x02 0xda792301 0x00 0x2db0323 0x1000000 0x2dc87 0x23010000 0x2dd 0x3230100 0x02 0xde962301 0x00 0x2df0323 0x1000000 0x2e0a6 0x23010000 0x2e1 0x3230100 0x02 0xe2b72301 0x00 0x2e30323 0x1000000 0x2e4ca 0x23010000 0x2e5 0x3230100 0x02 0xe6de2301 0x00 0x2e70323 0x1000000 0x2e8f4 0x23010000 0x2e9 0x3230100 0x02 0xeaff2301 0x00 0x2fb0123 0x1000000 0x2ff20 0x23010000 0x211 0x1d230100 0x02 0x121d2301 0x00 0x2130323 0x1000000 0x2ff10 0x23010000 0x235 0x230100 0x02 0x44053901 0x00 0x52a0000 0x4373901 0x00 0x52b0000 0x77f0501 0x6000 0x2110005 0x1000010 0x22900 >;
		qcom,mdss-dsi-off-command-gesture = [ 23 01 00 00 00 00 02 ff 10 05 01 00 00 00 00 02 28 00 05 01 00 00 60 00 02 10 00 ];
		qcom,mdss-dsi-off-command = < 0x23010000 0x2ff 0x10050100 0x02 0x28000501 0x6000 0x2100023 0x1000010 0x24f01 >;
		qcom,mdss-dsi-on-command-state = "dsi_hs_mode";
		qcom,mdss-dsi-off-command-state = "dsi_hs_mode";
		qcom,mdss-dsi-h-sync-pulse = <1>;
		qcom,mdss-dsi-traffic-mode = "burst_mode";
		qcom,mdss-dsi-lane-map = "lane_map_0123";
		qcom,mdss-dsi-bllp-eof-power-mode;
		qcom,mdss-dsi-bllp-power-mode;
		qcom,mdss-dsi-lane-0-state;
		qcom,mdss-dsi-lane-1-state;
		qcom,mdss-dsi-lane-2-state;
		qcom,mdss-dsi-lane-3-state;
		qcom,mdss-dsi-te-pin-select = <1>;
		qcom,mdss-dsi-wr-mem-start = <44>;
		qcom,mdss-dsi-wr-mem-continue = <60>;
		qcom,mdss-dsi-te-dcs-command = <1>;
		qcom,mdss-dsi-te-check-enable;
		qcom,mdss-dsi-te-using-te-pin;
		qcom,mdss-dsi-panel-timings = [f9 3d 34 00 58 4d 36 3f 53 03 04 00];
		qcom,mdss-dsi-t-clk-post = <0x1e>;
		qcom,mdss-dsi-t-clk-pre = <0x38>;
		qcom,mdss-dsi-bl-min-level = <1>;
		qcom,mdss-dsi-bl-max-level = <4095>;
		qcom,mdss-dsi-dma-trigger = "trigger_sw";
		qcom,mdss-dsi-mdp-trigger = "none";
		qcom,mdss-dsi-bl-pmic-control-type = "bl_ctrl_wled";
		qcom,mdss-dsi-reset-sequence = <1 5 0 5 1 5>;
		qcom,panel-supply-entries = <&dsi_panel_pwr_supply>;
	};
};

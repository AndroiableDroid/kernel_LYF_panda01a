&mdss_mdp {
	dsi_ssd2098_1080_vid: qcom,mdss_dsi_ssd2098_1080p_video {
		qcom,mdss-dsi-panel-name = "ssd2098 1080p video mode dsi panel";
		qcom,mdss-dsi-panel-controller = < 0x31 >;
		qcom,mdss-dsi-panel-type = "dsi_video_mode";
		qcom,mdss-dsi-panel-destination = "display_1";
		qcom,mdss-dsi-panel-framerate = < 0x3c >;
		qcom,mdss-dsi-virtual-channel-id = < 0x00 >;
		qcom,mdss-dsi-stream = < 0x00 >;
		qcom,mdss-dsi-panel-width = < 0x438 >;
		qcom,mdss-dsi-panel-height = < 0x780 >;
		qcom,mdss-pan-physical-width-dimension = < 0x41 >;
		qcom,mdss-pan-physical-height-dimension = < 0x73 >;
		qcom,mdss-dsi-h-front-porch = < 0x14 >;
		qcom,mdss-dsi-h-back-porch = < 0x14 >;
		qcom,mdss-dsi-h-pulse-width = < 0x04 >;
		qcom,mdss-dsi-h-sync-skew = < 0x00 >;
		qcom,mdss-dsi-v-back-porch = < 0x9f >;
		qcom,mdss-dsi-v-front-porch = < 0xfd >;
		qcom,mdss-dsi-v-pulse-width = < 0x01 >;
		qcom,mdss-dsi-h-left-border = < 0x00 >;
		qcom,mdss-dsi-h-right-border = < 0x00 >;
		qcom,mdss-dsi-v-top-border = < 0x00 >;
		qcom,mdss-dsi-v-bottom-border = < 0x00 >;
		qcom,mdss-dsi-bpp = < 0x18 >;
		qcom,mdss-dsi-color-order = "rgb_swap_rgb";
		qcom,mdss-dsi-underflow-color = < 0xff >;
		qcom,mdss-dsi-border-color = < 0x00 >;
		qcom,mdss-dsi-on-command = < 0x29010000 0x3b5 0x2901 0x00 0x3b30396 0x29010000 0x3b3 0x15802901 0x00 0x3b31e02 0x29010000 0x3b3 0x16502901 0x00 0x3b31ce4 0x29010000 0x3b3 0x28132901 0x00 0x3b3241f 0x29010000 0x3b0 0x12002901 0x00 0x3b01324 0x29010000 0x3b0 0x1a002901 0x00 0x3b01b24 0x29010000 0x3c1 0xd872901 0x00 0x3c10e87 0x29010000 0x3bb 0x1832901 0x00 0x3bb0221 0x29010000 0x3bb 0x3042901 0x00 0x3bb0448 0x29010000 0x3bb 0x5322901 0x00 0x3bb0644 0x29010000 0x3bb 0x7cd2901 0x00 0x3bb08e4 0x29010000 0x3bb 0x9442901 0x00 0x3bb0a01 0x29010000 0x3bb 0xbe02901 0x00 0x3bb0c00 0x29010000 0x3bb 0xd832901 0x00 0x3bb0e21 0x29010000 0x3bb 0xf042901 0x00 0x3bb1048 0x29010000 0x3bb 0x11322901 0x00 0x3bb1244 0x29010000 0x3bb 0x13cd2901 0x00 0x3bb14e4 0x29010000 0x3bb 0x15442901 0x00 0x3bb1601 0x29010000 0x3bb 0x17e02901 0x00 0x3bb1800 0x29010000 0x3bd 0xf02901 0x00 0x3bd01c0 0x29010000 0x3bd 0x2f02901 0x00 0x3bd03c0 0x29010000 0x3bd 0x1a572901 0x00 0x3bd1b93 0x29010000 0x3bd 0x1d022901 0x00 0x3bd1e03 0x29010000 0x3bd 0x21002901 0x00 0x3bd2346 0x29010000 0x3bd 0x24822901 0x00 0x3bd2602 0x29010000 0x3bd 0x27032901 0x00 0x3bd2a00 0x29010000 0x3bd 0x2c772901 0x00 0x3bd2d77 0x29010000 0x3bd 0x2e002901 0x00 0x3bd2f00 0x29010000 0x3bd 0x31002901 0x00 0x3bd3400 0x29010000 0x3bd 0x35002901 0x00 0x3bd3700 0x29010000 0x3bd 0x3af02901 0x00 0x3bd3bf0 0x29010000 0x3bd 0x3cf02901 0x00 0x3bd3df1 0x29010000 0x3bd 0x40002901 0x00 0x3bd42f0 0x29010000 0x3bd 0x43f02901 0x00 0x3bd44f0 0x29010000 0x3bd 0x45f12901 0x00 0x3bd4800 0x29010000 0x17c3 0x232e38 0x3e4c5664 0x6e818e94 0x919699a4 0xb6bb3f3c 0x6b722901 0x00 0x17c31523 0x2e383e4c 0x56646e81 0x8e949196 0x99a4b6bb 0x3f3c6b72 0x29010000 0x23d3 0x02 0x131a2027 0x2d343940 0x474d545a 0x62686e75 0x7d838990 0x979ea4aa 0xb1b8bec5 0xccd22901 0x00 0x13d3216e 0xaa00b6 0xdd00be 0xba006f 0x690080 0x29010000 0x23d4 0x03 0x151d242b 0x33394048 0x4f565e66 0x6d747d84 0x8b929aa1 0xa8b0b7be 0xc6cdd5dc 0xe4ea2901 0x00 0x13d4217a 0x6e00aa 0xe600da 0xfb00ae 0xe90080 0x29010000 0x3b0 0x29052901 0x00 0x3b02a10 0x29010000 0x3d0 0x1b812901 0x00 0x3bc0701 0x29010000 0x3bc 0x8012901 0x00 0x3bc0901 0x29010000 0x3b4 0x21ff2901 0x00 0x3e10001 0x29010000 0x4e1 0x300fd29 0x1000000 0x6b004 0x11b80c94 0x29010000 0x3b0 0x6a02901 0x00 0x3b92b94 0x29010000 0x4c6 0x34029 0x1000000 0x3ba0f 0x58290100 0x06 0xba170c79 0x98182901 0x00 0x4ba257c 0x41290100 0x07 0xba200223 0x231d1d29 0x1000000 0x3c604 0x2d290100 0x03 0xb90e4429 0x1000000 0x3bc00 0xf0290100 0x03 0xbc014e29 0x1000000 0x3bc00 0xf4290100 0x03 0xbc015e29 0x1000000 0x3bc0e 0x73290100 0x03 0xbc0f7729 0x1000000 0x3bc1e 0xc0290100 0x03 0xbc243329 0x1000000 0x3bc0e 0x77290100 0x03 0xbc00fc29 0x1000000 0x3b802 0x10290100 0x03 0xc10c2629 0x1000000 0x3b923 0x290100 0x03 0xc2040f29 0x1000000 0x3b911 0x22290100 0x03 0xb9122229 0x1000000 0x3b913 0x22290100 0x03 0xbb198029 0x1000000 0x3bb1a 0x12290100 0x03 0xbb1b3429 0x1000000 0x3bb1c 0x48290100 0x03 0xbb1d2329 0x1000000 0x3bb1e 0x44290100 0x03 0xbb1fcd29 0x1000000 0x3bb20 0xe4290100 0x03 0xbb214429 0x1000000 0x3bb22 0x1290100 0x03 0xbb23e029 0x1000000 0x3bb24 0x290100 0x03 0xbb258029 0x1000000 0x3bb26 0x12290100 0x03 0xbb273429 0x1000000 0x3bb28 0x48290100 0x03 0xbb292329 0x1000000 0x3bb2a 0x44290100 0x03 0xbb2bcd29 0x1000000 0x3bb2c 0xe4290100 0x03 0xbb2d4429 0x1000000 0x3bb2e 0x1290100 0x03 0xbb2fe029 0x1000000 0x3bb30 0x290100 0x03 0xb03dc829 0x1000000 0x3b30f 0x20290100 0x02 0x36022901 0x00 0x3c70109 0x5010000 0x111 0x5010000 0x129 >;
		qcom,mdss-dsi-off-command = [ 29 01 00 00 96 00 03 c6 00 00 15 01 00 00 10 00 02 4f 01 05 01 00 00 00 00 02 28 00 05 01 00 00 64 00 02 10 00 ];
		qcom,mdss-dsi-off-command-gesture = [ 05 01 00 00 00 00 02 28 00 05 01 00 00 64 00 02 10 00 ];
		qcom,mdss-dsi-on-command-state = "dsi_lp_mode";
		qcom,mdss-dsi-off-command-state = "dsi_lp_mode";
		qcom,mdss-dsi-h-sync-pulse = < 0x01 >;
		qcom,mdss-dsi-traffic-mode = "burst_mode";
		qcom,mdss-dsi-lane-map = "lane_map_0123";
		qcom,mdss-dsi-bllp-eof-power-mode;
		qcom,mdss-dsi-bllp-power-mode;
		qcom,mdss-dsi-lane-0-state;
		qcom,mdss-dsi-lane-1-state;
		qcom,mdss-dsi-lane-2-state;
		qcom,mdss-dsi-lane-3-state;
		qcom,mdss-dsi-panel-timings = < 0xf93d3400 0x584d363f 0x53030400 >;
		qcom,mdss-dsi-t-clk-post = < 0x1e >;
		qcom,mdss-dsi-t-clk-pre = < 0x38 >;
		qcom,mdss-dsi-bl-min-level = < 0x01 >;
		qcom,mdss-dsi-bl-max-level = < 0xfff >;
		qcom,mdss-dsi-dma-trigger = "trigger_sw";
		qcom,mdss-dsi-mdp-trigger = "none";
		qcom,mdss-dsi-bl-pmic-control-type = "bl_ctrl_wled";
		qcom,mdss-dsi-reset-sequence = < 0x01 0x0a 0x00 0x0a 0x01 0x0a >;
		qcom,panel-supply-entries = < 0x32 >;
	};
};
